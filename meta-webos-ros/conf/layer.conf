## meta-webos-ros/conf/layer.conf
```bitbake
# We have a conf and classes directory, append to BBPATH
BBPATH .= ":${LAYERDIR}"

# We have a recipes directory, add to BBFILES
BBFILES += "${LAYERDIR}/recipes-*/*/*.bb ${LAYERDIR}/recipes-*/*/*.bbappend"

BBFILE_COLLECTIONS += "meta-webos-ros"
BBFILE_PATTERN_meta-webos-ros := "^${LAYERDIR}/"
BBFILE_PRIORITY_meta-webos-ros = "52"

# Version 1 was the manually created meta-ros, prior to the introduction of superflore.
# Version 2 was all ROS distributions in the same meta-ros layer with right subdirectories selected by ROS_DISTRO variable
# Version 3 is with each ROS distribution in separate sublayer of meta-ros git repository (with modifications to generated recipes applied in .bbappends instead of .inc files)
LAYERVERSION_meta-webos-ros = "3"

LAYERDEPENDS_meta-webos-ros = " \
    core \
    meta-python \
    openembedded-layer \
    ros-common-layer \
"

LAYERSERIES_COMPAT_meta-webos-ros = "thud warrior"

PNBLACKLIST[python-orocos-kdl] ?= "depends on sip-native unavailable in our builds http://caprica.lgsvl.com:8080/Errors/Details/1509128"
PNBLACKLIST[kobuki-testsuite] ?= "depends on blacklisted python-orocos-kdl"
PNBLACKLIST[kdl-parser-py] ?= "depends on blacklisted python-orocos-kdl"

BBMASK +=  "recipes-kernel/linux/linux-raspberrypi_4.4.bbappend"
BBMASK +=  "recipes-graphics/userland/userland_git.bbappend"

PREFERRED_VERSION_linux-raspberrypi_raspberrypi3 = "4.19.%"
```
